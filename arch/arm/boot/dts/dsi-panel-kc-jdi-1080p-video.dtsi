/*
 * This software is contributed or developed by KYOCERA Corporation.
 * (C) 2014 KYOCERA Corporation
 */
/* Copyright (c) 2013, The Linux Foundation. All rights reserved.
 *
 * This program is free software; you can redistribute it and/or modify
 * it under the terms of the GNU General Public License version 2 and
 * only version 2 as published by the Free Software Foundation.
 *
 * This program is distributed in the hope that it will be useful,
 * but WITHOUT ANY WARRANTY; without even the implied warranty of
 * MERCHANTABILITY or FITNESS FOR A PARTICULAR PURPOSE.  See the
 * GNU General Public License for more details.
 */

/*---------------------------------------------------------------------------
 * This file is autogenerated file using gcdb parser. Please do not edit it.
 * Update input XML file to add a new entry or update variable in this file
 * VERSION = "1.0"
 *---------------------------------------------------------------------------*/
&mdss_mdp {
	dsi_kc_jdi_1080p_vid: qcom,mdss_dsi_kc_jdi_1080p_video {
		qcom,mdss-dsi-panel-name = "kc_jdi 1080p video mode dsi panel";
		qcom,mdss-dsi-panel-controller = <&mdss_dsi0>;
		qcom,mdss-dsi-panel-type = "dsi_video_mode";
		qcom,mdss-dsi-panel-destination = "display_1";
		qcom,mdss-dsi-panel-framerate = <60>;
		qcom,mdss-dsi-virtual-channel-id = <0>;
		qcom,mdss-dsi-stream = <0>;
		qcom,mdss-dsi-panel-width = <1080>;
		qcom,mdss-dsi-panel-height = <1920>;
		qcom,mdss-pan-physical-width-dimension=<61>;
		qcom,mdss-pan-physical-height-dimension=<110>;
		qcom,mdss-dsi-h-front-porch = <101>;
		qcom,mdss-dsi-h-back-porch = <40>;
		qcom,mdss-dsi-h-pulse-width = <10>;
		qcom,mdss-dsi-h-sync-skew = <0>;
		qcom,mdss-dsi-v-back-porch = <4>;
		qcom,mdss-dsi-v-front-porch = <8>;
		qcom,mdss-dsi-v-pulse-width = <4>;
		qcom,mdss-dsi-h-left-border = <0>;
		qcom,mdss-dsi-h-right-border = <0>;
		qcom,mdss-dsi-v-top-border = <0>;
		qcom,mdss-dsi-v-bottom-border = <0>;
		qcom,mdss-dsi-bpp = <24>;
		qcom,mdss-dsi-color-order = <0>;
		qcom,mdss-dsi-underflow-color = <0xff>;
		qcom,mdss-dsi-border-color = <0>;
		qcom,mdss-dsi-on-command = [
					05 01 00 00 05 00 01 01             /* soft reset -> wait 5ms */
					23 01 00 00 00 00 02 B0 00          /* MCAP */

					39 01 00 00 00 00 03                /* write display brightness */
						51 00 ff

					15 01 00 00 00 00 02                /* write control display */
						53 2c

					15 01 00 00 00 00 02                /* write content adaptive brightness control 00:off, 01:UI, 02:Still, 03:Movie */
						55 01

					29 01 00 00 00 00 04                /* Backlight control5 */
						cd 00 00 ff

					29 01 00 00 00 00 08                /* Backlight control26 */
						ce 00 01 00 c1 00 00 00

					29 01 00 00 00 00 1a                /* Backlight contrl1 */
						b8 18 80 18 18 cf 1f 00
						0c 0a 4c 0a 6c 0a 0c 0a
						da 6d ff ff 10 e5 ff ff
						ff ff

					29 01 00 00 00 00 08                /* Backlight control2 */
						b9 00 3f 18 18 9f 1f 80

					29 01 00 00 00 00 08                /* Backlight control3 */
						ba 00 3f 04 40 9f 1f d7

					29 01 00 00 00 00 19                /* rw_display_gamma_r */
						c7 07 0f 13 1c 2b 43 32
						3d 44 4e 62 78 07 0f 13
						1c 2b 43 32 3d 44 4e 62
						78

					29 01 00 00 00 00 19                /* rw_display_gamma_g */
						c8 07 13 1d 29 37 4a 35
						3f 46 4e 57 78 07 13 1d
						29 37 4a 35 3f 46 4e 57
						78

					29 01 00 00 00 00 19                /* rw_display_gamma_b */
						c9 07 2f 32 3b 44 51 37
						40 48 50 59 78 07 2f 32
						3b 44 51 37 40 48 50 59
						78
					];

		qcom,mdss-dsi-on-post-command = [
					05 01 00 00 78 00 01 11             /* exit sleep mode -> wait 120ms */
					05 01 00 00 00 00 01 29             /* set display on */
					];

		qcom,mdss-dsi-off-command = [
					05 01 00 00 14 00 01 28             /* set display off -> wait 20ms */
					05 01 00 00 50 00 01 10             /* enter sleep mode -> wait 80ms */
					];

		qcom,mdss-dsi-off-post-command = [
					23 01 00 00 00 00 02 B0 00          /* MCAP */
					23 01 00 00 00 00 02 B1 01          /* DSTB = 1 */
					];
					
		qcom,mdss-dsi-on-command-state = "dsi_lp_mode";
		qcom,mdss-dsi-on-post-command-state = "DSI_LP_MODE";                /* dummy */
		qcom,mdss-dsi-off-command-state = "dsi_hs_mode";
		qcom,mdss-dsi-off-post-command-state = "DSI_LP_MODE";                /* dummy */
		qcom,mdss-dsi-h-sync-pulse = <0>;
		qcom,mdss-dsi-traffic-mode = "non_burst_sync_event";
		qcom,mdss-dsi-lane-map = <0>;
		qcom,mdss-dsi-bllp-eof-power-mode = <1>;
		qcom,mdss-dsi-bllp-power-mode = <1>;
		qcom,mdss-dsi-lane-0-state = <1>;
		qcom,mdss-dsi-lane-1-state = <1>;
		qcom,mdss-dsi-lane-2-state = <1>;
		qcom,mdss-dsi-lane-3-state = <1>;
		qcom,mdss-dsi-panel-timings = [f6 44 38 00 5e e8 3a 46 58 02 04 00];
		qcom,mdss-dsi-t-clk-post = <0x1e>;
		qcom,mdss-dsi-t-clk-pre = <0x36>;
		qcom,mdss-dsi-bl-min-level = <1>;
		qcom,mdss-dsi-bl-max-level = <4095>;
		qcom,mdss-dsi-dma-trigger = <4>;
		qcom,mdss-dsi-mdp-trigger = "none";
		qcom,mdss-dsi-tx-eot-append = <1>;
		qcom,mdss-dsi-te-pin-select = <0>;
		qcom,mdss-dsi-bl-pmic-control-type = "bl_ctrl_wled";
		qcom,mdss-dsi-pan-enable-dynamic-fps;
		qcom,mdss-dsi-pan-fps-update = "dfps_suspend_resume_mode";
		qcom,mdss-dsi-reset-sequence = <1 20>, <0 200>, <1 20>;

	};
};
